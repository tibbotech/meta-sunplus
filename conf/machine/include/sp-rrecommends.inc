## conf/machine/include/sp-rrecommends.inc
```bitbake
MACHINE_FEATURES  = "serial rtc"
MACHINE_FEATURES += "usbhost"
MACHINE_FEATURES += "usbgadget"
MACHINE_FEATURES += "ext2 vfat"
MACHINE_FEATURES += "bluetooth wifi 3g ppp"
MACHINE_FEATURES += "alsa"
MACHINE_FEATURES += "media-usb-webcams"
MACHINE_FEATURES += "media"
MACHINE_FEATURES += "tpsleds"
# for usb modems ?
# MACHINE_FEATURES += "serial-all usb-net"
MACHINE_FEATURES += "touchscreen"

MACHINE_EXTRA_RRECOMMENDS  = "kernel-modules kernel-devicetree"
MACHINE_EXTRA_RRECOMMENDS += "kernel-module-snd kernel-module-snd-timer kernel-module-snd-hrtimer"
MACHINE_EXTRA_RRECOMMENDS += "kernel-module-snd-pcm kernel-module-snd-compress-offload"
MACHINE_EXTRA_RRECOMMENDS += "kernel-module-snd-hwdep kernel-module-snd-rawmidi"
MACHINE_EXTRA_RRECOMMENDS += "kernel-module-snd-sequencer"
MACHINE_EXTRA_RRECOMMENDS += "kernel-module-snd-seq-midi kernel-module-snd-seq-midi-event"
MACHINE_EXTRA_RRECOMMENDS += "kernel-module-snd-opl3-lib kernel-module-snd-opl3-lib-seq"
MACHINE_EXTRA_RRECOMMENDS += "kernel-module-snd-aloop"
MACHINE_EXTRA_RRECOMMENDS += "kernel-module-snd-simple-card kernel-module-snd-simple-card-utils"
MACHINE_EXTRA_RRECOMMENDS += "kernel-module-snd-usb-audio"
```

## recipes-kernel/linux/linux-sp-5.4/kmeta/bsp/pentagram/1w/ds2430/Kconfig.ds2430.patch
```kconfig
--- a/drivers/w1/slaves/Kconfig	2023-05-30 04:45:06.103162817 +0300
+++ a/drivers/w1/slaves/Kconfig	2023-05-30 15:08:24.055320528 +0300
@@ -25,6 +25,14 @@
 	  This device can also work as a single-channel
 	  binary remote sensor.
 
+config W1_SLAVE_DS2430
+	tristate "256b EEPROM family support (DS2430)"
+	help
+	  Say Y here if you want to use a 1-wire 256bit EEPROM
+	  family device (DS2430).
+	  This EEPROM is organized as one page of 32 bytes for random
+	  access.
+
 config W1_SLAVE_DS2408
 	tristate "8-Channel Addressable Switch (IO Expander) 0x29 family support (DS2408)"
 	help
```
